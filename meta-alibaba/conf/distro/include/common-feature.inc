## meta-alibaba/conf/distro/include/common-feature.inc
```bitbake
require conf/distro/include/phosphor-base.inc

IMAGE_INSTALL_append = " ipmitool"
```

## meta-alibaba/conf/layer.conf
```bitbake
# We have a conf and classes directory, add to BBPATH
BBPATH .= ":${LAYERDIR}"
# We have recipes-* directories, add to BBFILES
BBFILES += "${LAYERDIR}/meta-comm-origin/recipes-*/*/*.bb \
            ${LAYERDIR}/meta-comm-origin/recipes-*/*/*.bbappend \
            ${LAYERDIR}/meta-comm-oem/recipes-*/*/*.bb \
            ${LAYERDIR}/meta-comm-oem/recipes-*/*/*.bbappend"

BBFILE_COLLECTIONS += "alibaba-layer"
BBFILE_PATTERN_alibaba-layer = "^${LAYERDIR}/"
LAYERSERIES_COMPAT_alibaba-layer = "warrior zeus dunfell"
```

## meta-alibaba/conf/machine/include/common-bsp-ast2500.inc
```bitbake
KMACHINE = "aspeed"
require conf/machine/include/ast2500.inc

UBOOT_MACHINE = "ast_g5_phy_config"
PREFERRED_PROVIDER_virtual/obmc-system-mgmt = "packagegroup-alibaba-apps"
PREFERRED_PROVIDER_virtual/obmc-tools-mgmt = "packagegroup-alibaba-apps"
```

## meta-alibaba/meta-thor/conf/machine/thor.conf
```bitbake
KERNEL_DEVICETREE = "${KMACHINE}-alibaba-${MACHINE}.dtb"
require conf/machine/include/common-bsp-ast2500.inc

UBOOT_MACHINE = "ast_g5_phy_config"
FLASH_SIZE = "32768"

# below contents will be gathered by macro 'MACHINE_FEATURES' which defined in phosphor-base.inc file
OBMC_MACHINE_FEATURES += "\
        "
VIRTUAL-RUNTIME_skeleton_workbook = "alibaba-ast2500-config"
```
